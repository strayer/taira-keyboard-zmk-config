## config/boards/shields/taira/Kconfig.defconfig
```kconfig
# Copyright (c) 2020 The ZMK Contributors
# SPDX-License-Identifier: MIT

if SHIELD_TAIRA_LEFT

config ZMK_KEYBOARD_NAME
	default "Taira"

config ZMK_SPLIT_BLE_ROLE_CENTRAL
	default y

endif

if SHIELD_TAIRA_LEFT || SHIELD_TAIRA_RIGHT

config ZMK_SPLIT
	default y

endif
```

## config/boards/shields/taira/Kconfig.shield
```kconfig
# Copyright (c) 2020 The ZMK Contributors
# SPDX-License-Identifier: MIT

config SHIELD_TAIRA_LEFT
	def_bool $(shields_list_contains,taira_left)

config SHIELD_TAIRA_RIGHT
	def_bool $(shields_list_contains,taira_right)
```
